## Kconfig
```kconfig
menuconfig MAVWRAP
	bool "MAVLink Wrapper"
	help
	  Enable MAVLink communication wrapper with support for
	  multiple transport types (UART, UDP network).

if MAVWRAP

choice MAVWRAP_DIALECT
	prompt "MAVLink Dialect"
	default MAVWRAP_DIALECT_COMMON
	help
	  Select the MAVLink message dialect to use.
	  The dialect determines which message set is available.

config MAVWRAP_DIALECT_COMMON
	bool "common"
	help
	  MAVLink common dialect. Includes the base message set
	  shared across all MAVLink implementations.

config MAVWRAP_DIALECT_ARDUPILOTMEGA
	bool "ardupilotmega"
	help
	  ArduPilot MAVLink dialect. Superset of common, includes
	  ArduPilot-specific messages for copters, planes, and rovers.

config MAVWRAP_DIALECT_CUSTOM
	bool "custom"
	help
	  A custom MAVLink dialect. Set MAVWRAP_DIALECT_NAME to the
	  folder name generated by mavgen.

endchoice

# Automatically set for built-in dialects, user-defined for custom
config MAVWRAP_DIALECT_NAME
	string "MAVLink dialect folder name"
	default "common"          if MAVWRAP_DIALECT_COMMON
	default "ardupilotmega"   if MAVWRAP_DIALECT_ARDUPILOTMEGA
	default ""                if MAVWRAP_DIALECT_CUSTOM
	help
	  The folder name of the dialect as generated by mavgen.
	  Automatically set for built-in dialects. For custom dialects,
	  set this to the XML filename used to generate the headers.

config MAVWRAP_LOG_LEVEL
	int "MAVLink Wrapper Log Level"
	default 3
	range 0 4
	help
	  Log level for MAVLink wrapper driver:
	    0 = OFF
	    1 = ERROR
	    2 = WARNING
	    3 = INFO
	    4 = DEBUG

config MAVWRAP_TRANSPORT_UART
	bool "UART Transport Support"
	depends on SERIAL
	help
	  Enable UART transport for MAVLink communication.

config MAVWRAP_TRANSPORT_LORA
	bool "LoRa Transport Support"
	depends on LORA
	help
	  Enable LoRa transport for MAVLink communication.

if MAVWRAP_TRANSPORT_LORA

config MAVWRAP_LORA_TX_TIMEOUT_MS
	int "LoRa TX Timeout (ms)"
	default 5000
	range 1000 30000
	help
	  Timeout for blocking lora_send(). LoRa airtime can be
	  several seconds at high spreading factors (SF11/SF12).

endif # MAVWRAP_TRANSPORT_LORA

config MAVWRAP_TRANSPORT_NETIF
	bool "Network Transport Support"
	depends on NETWORKING
	select NET_CONTEXT
	select NET_SOCKETS
	select NET_IPV4
	select NET_UDP
	help
	  Enable network transport for MAVLink communication.

config MAVWRAP_RX_STACK_SIZE
	int "RX Thread Stack Size"
	default 2048
	range 1024 8192
	help
	  Stack size for the MAVLink RX parsing thread.
	  Increase if you experience stack overflows.

config MAVWRAP_RX_THREAD_PRIORITY
	int "RX Thread Priority"
	default 5
	range 1 99
	help
	  Priority for the MAVLink RX parsing thread.
	  Lower values = higher priority.

config MAVWRAP_RX_RING_SIZE
	int "RX Ring Buffer Size"
	default 1024
	range 256 4096
	help
	  Size of the RX ring buffer in bytes.
	  Increase if you experience buffer overflows with high-rate messages.

if MAVWRAP_TRANSPORT_UART

config MAVWRAP_UART_TX_TIMEOUT_MS
	int "UART TX Timeout (ms)"
	default 1000
	range 100 5000
	help
	  Timeout in milliseconds for UART transmission.
	  Applies to both DMA and IRQ modes.

if UART_ASYNC_API

config MAVWRAP_UART_DMA_RX_BUF_SIZE
	int "UART DMA RX Buffer Size"
	default 512
	range 128 2048
	help
	  Size of each UART DMA RX buffer (double buffered).

config MAVWRAP_UART_RX_TIMEOUT_MS
	int "UART RX Timeout (ms)"
	default 100
	range 10 1000
	help
	  Timeout in milliseconds for UART async RX mode.
	  Used for flushing partial packets.

endif # UART_ASYNC_API

config MAVWRAP_UART_IRQ_RX_BUF_SIZE
	int "UART IRQ RX Buffer Size"
	default 32
	range 16 256
	help
	  Size of temporary RX buffer for UART IRQ mode.
	  Data is immediately copied to ring buffer.
	  Larger values may improve performance on high baud rates.

endif # MAVWRAP_TRANSPORT_UART

config MAVWRAP_TX_THREAD
	bool "TX Thread"
	help
	  Use a dedicated thread for sending MAVLink messages.
	  When enabled, mavwrap_send_message() enqueues the message
	  and returns immediately (non-blocking).

if MAVWRAP_TX_THREAD

config MAVWRAP_TX_QUEUE_SIZE
	int "TX Queue Depth"
	default 4
	range 2 16
	help
	  Number of messages that can be queued for transmission.
	  If the queue is full, the message is dropped.

config MAVWRAP_TX_STACK_SIZE
	int "TX Thread Stack Size"
	default 2048
	range 1024 4096
	help
	  Stack size for the MAVLink TX thread.
	  Network transports (UDP) require at least 2048 bytes.

config MAVWRAP_TX_THREAD_PRIORITY
	int "TX Thread Priority"
	default 6
	range 1 99
	help
	  Priority for the MAVLink TX thread.
	  Lower values = higher priority.

endif # MAVWRAP_TX_THREAD

config MAVWRAP_INIT_PRIORITY
	int "Initialization Priority"
	default 95
	range 1 99
	help
	  Initialization priority for MAVLink wrapper devices.
	  Must be greater than LORA_INIT_PRIORITY (90) and SPI_INIT_PRIORITY.

if MAVWRAP_TRANSPORT_NETIF

config MAVWRAP_NETIF_CONNECT_TIMEOUT_MS
	int "Network Connection Timeout (ms)"
	default 5000
	range 1000 30000
	help
	  Timeout in milliseconds for network connection and DHCP.
	  Increase if your network takes longer to initialize.

config MAVWRAP_NETIF_SEND_TIMEOUT_MS
	int "Network Send Timeout (ms)"
	default 1000
	range 100 5000
	help
	  Timeout in milliseconds for sending packets over network.

endif # MAVWRAP_TRANSPORT_NETIF

endif # MAVWRAP
```

## dts/bindings/mavlink-wrapper.yaml
```yaml
# MAVLink Wrapper Devicetree Bindings

description: |
  MAVLink communication wrapper for Zephyr RTOS.

compatible: "mavlink-wrapper"

properties:
  label:
    type: string
    description: |
      Human-readable label for this MAVLink instance.
      Used in logs and shell commands.
      Example: "GCS", "Telemetry", "Companion"
  
  transport:
    type: phandle
    required: true
    description: |
      Reference to the transport interface used by this MAVLink instance.
      This should point to a UART or network device.

  serial-interface:
    type: boolean
    description: |
      Indicates if this MAVLink instance uses a serial interface (UART).
      Mutually exclusive with net-interface.

  net-interface:
    type: boolean
    description: |
      Indicates if this MAVLink instance uses network transport.
      If true, network configuration properties are required.
      Mutually exclusive with serial-interface.
    
  lora-interface:
    type: boolean
    description: |
      Indicates if this MAVLink instance uses lora transport.

  net-type:
    type: string
    required: false
    enum:
      - "udp"
    description: |
      Network transport protocol type.

  use-dhcp:
    type: boolean
    description: |
      If true, enables DHCP for this MAVLink network interface.
      If false, static IP configuration (local-ip) must be provided.
      Default: false

  local-ip:
    type: string
    description: |
      Local IP address (IPv4) for network transport.
      Required if use-dhcp is false.
      Example: "192.168.1.100"
      Default: "0.0.0.0"

  local-port:
    type: int
    default: 14550
    description: |
      Local port for network transport (bind port).
      For UDP: the port to listen on.
      Default: 14550

  remote-ip:
    type: string
    default: "0.0.0.0"
    description: |
      Remote IP address (IPv4) for network transport.
      For UDP: the destination IP for sent packets.
      Example: "192.168.1.1"
      Default: "0.0.0.0"

  remote-port:
    type: int
    default: 14551
    description: |
      Remote port for network transport.
      For UDP: the destination port for sent packets.
      Default: 14551

  lora-frequency:
    type: int
    description: |
      LoRa center frequency in Hz.
      Example: 868000000 (868 MHz), 915000000 (915 MHz)

  lora-bandwidth:
    type: int
    enum:
      - 125
      - 250
      - 500
    description: |
      LoRa signal bandwidth in kHz.
      Default: 125

  lora-spreading-factor:
    type: int
    description: |
      LoRa spreading factor (6..12).
      Higher SF = longer range, lower data rate, longer airtime.

  lora-coding-rate:
    type: int
    enum:
      - 5
      - 6
      - 7
      - 8
    description: |
      LoRa coding rate denominator: 5=4/5, 6=4/6, 7=4/7, 8=4/8.
      Default: 5 (4/5)

  lora-tx-power:
    type: int
    description: |
      LoRa TX power in dBm.
      Valid range depends on hardware (typically 2..20 dBm for SX1276).

  lora-preamble-length:
    type: int
    default: 8
    description: |
      LoRa preamble length in symbols.
      Default: 8
```
